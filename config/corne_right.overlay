
/*
 * Copyright (c) 2020 Pete Johanson
 *
 * SPDX-License-Identifier: MIT
 */


// From Pete: https://discord.com/channels/719497620560543766/845285481888743434/1206181117296644106
&pro_micro_i2c {
    status = "okay";
    glidepoint: glidepoint@2a {
        compatible = "cirque,pinnacle";
        reg = <0x2a>;
        status = "okay";
        dr-gpios = <&pro_micro	3	GPIO_ACTIVE_HIGH>;
        sensitivity = "1x";
        sleep;
        #no-taps;
    };
};



/ {
    // Rotation config, from Pete
    // This will change in the future
    // https://discord.com/channels/719497620560543766/845285481888743434/1206407883777114182
    input_config {
        compatible = "zmk,input-listener";
        device = <&glidepoint>;
        xy-swap;
        y-invert;
        x-invert;
	scale-multiplier = <3>;
	scale-divisor = <2>;
    };
};
